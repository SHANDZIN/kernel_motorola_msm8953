/* Copyright (c) 2018, Motorola Mobility Inc. All rights reserved.
 *
 * This program is free software; you can redistribute it and/or modify
 * it under the terms of the GNU General Public License version 2 and
 * only version 2 as published by the Free Software Foundation.
 *
 * This program is distributed in the hope that it will be useful,
 * but WITHOUT ANY WARRANTY; without even the implied warranty of
 * MERCHANTABILITY or FITNESS FOR A PARTICULAR PURPOSE.  See the
 * GNU General Public License for more details.
 */

&soc {
	et320: et320{
		compatible = "egistec,et320";
		status = "ok";
		reg = <0>;
		interrupt-parent = <&tlmm>;
		interrupts = <48 0x0>;
		egistec,gpio_irq    = <&tlmm 48 0x0>;
		egistec,gpio_rst    = <&tlmm 8 0x0>;
		egistec,gpio_ldo1p8_en = <&tlmm 36 0x0>;
		egistec,gpio_ldo3p3_en = <&tlmm 12 0x0>;
		pinctrl-names = "default", "suspend";
		pinctrl-0 =
		<&rst_active &int_active &ldo_en_active &ldo3_en_active>;
		pinctrl-1 =
		<&rst_suspend &int_suspend &ldo_en_suspend &ldo3_en_suspend>;
	};
};
